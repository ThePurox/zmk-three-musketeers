## boards/shields/the-three-musketeers/Kconfig.defconfig
```kconfig
if SHIELD_THE_THREE_MUSKETEERS

# Name must be less than 16 characters long!
config ZMK_KEYBOARD_NAME
    default "the musketeers"

endif
```

## boards/shields/the-three-musketeers/Kconfig.shield
```kconfig
# No whitespace after the comma or in your keyboard name!
config SHIELD_THE_THREE_MUSKETEERS
    def_bool $(shields_list_contains,the_three_musketeers)
```
